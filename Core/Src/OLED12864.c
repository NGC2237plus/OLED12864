/**
 * @file   OLED12864.c
 * @author 早上坏 (star32349@outlook.com)
 * @brief  OLED显示屏模块的板级支持包（BSP）
 * @version 1.0
 * @date   2024/5/7
 * @see    http://t.csdnimg.cn/huaaY, http://t.csdnimg.cn/IEsBm
 * @link   https://github.com/NGC2237plus/OLED12864
 * @endlink
 */
#include "OLED12864.h"

#define IICx hi2c1
#define OLED_ADD 0x78  /*!< OLED的I2C地址（禁止修改）*/
#define OLED_COM 0x00  /*!< OLED 指令（禁止修改）*/
#define OLED_DAT 0x40  /*!< OLED 数据（禁止修改）*/
#define OLED_WIDTH 128 /*!< OLED像素宽度 */
#define OLED_HEIGHT 64 /*!< OLED像素高度 */
// uint8_t OLED_RAM[8][128];	   /*!< 定义GDDRAM缓存区，为了快速响应，提高刷新速度，本程序未使用缓冲区，原理与下方的图片显示相同 */

/**
 * @brief 6*8 ascll字符
 *
 */
const uint8_t ASCLL_6x8[][6] =
	{
		0x00, 0x00, 0x00, 0x00, 0x00, 0x00, /*!< sp */
		0x00, 0x00, 0x00, 0x2f, 0x00, 0x00, /*!< ! */
		0x00, 0x00, 0x07, 0x00, 0x07, 0x00, /*!< " */
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		0x00, 0x10, 0x08, 0x18, 0x10, 0x08, /*!< ~ */
};
/**
 * @brief  OLED屏幕初始化
 * @warning 使用OLED前必须调用该函数初始化
 * @retval 无
 */
void OLED_Init(void)
{
	WriteCmd(0xAE); // 关闭显示
	WriteCmd(0x20); // 设置存储器地址模式
	WriteCmd(0x10); // 00,水平地址模式;01,垂直地址模式;10,页面地址模式 (重置);11,无效
	WriteCmd(0xb0); // 设置页面地址模式的页面起始地址,0-7
	WriteCmd(0xc8); // 设置COM输出扫描方向
	WriteCmd(0x02); // ---设置低列地址
	WriteCmd(0x10); // ---设置高列地址
	WriteCmd(0x40); //--设置起始行地址
	WriteCmd(0x81); //--设置对比度控制寄存器
	WriteCmd(0xff); // 对比度范围 0x00~0xff
	WriteCmd(0xa1); //--设置段重映射 0到127
	WriteCmd(0xa6); //--设置正常显示
	WriteCmd(0xa8); //--设置复用比率(1到64)
	WriteCmd(0x3F); //
	WriteCmd(0xa4); // 0xa4,输出跟随RAM内容;0xa5,输出忽略RAM内容
	WriteCmd(0xd3); //-设置显示偏移
	WriteCmd(0x00); //-无偏移
	WriteCmd(0xd5); //--设置显示时钟分频比/振荡器频率
	WriteCmd(0xf0); //--设置分频比
	WriteCmd(0xd9); //--设置预充电周期
	WriteCmd(0x22); //
	WriteCmd(0xda); //--设置COM引脚硬件配置
	WriteCmd(0x12);
	WriteCmd(0xdb); //--设置VCOMH
	WriteCmd(0x20); // 0x20,0.77xVcc
	WriteCmd(0x8d); //--设置DC-DC启用
	WriteCmd(0x14); //
	WriteCmd(0xaf); //--打开OLED面板
}

/**
 * @brief 写命令
 * @retval 无
 */
void WriteCmd(uint8_t IIC_Command)
{
	HAL_I2C_WriteByte(OLED_COM, IIC_Command);
}

/**
 * @brief 写数据
 * @retval 无
 */
void WriteDat(uint8_t IIC_Data)
{
	HAL_I2C_WriteByte(OLED_DAT, IIC_Data);
}

/**
 * @brief IIC发送
 * @retval 无
 */
void HAL_I2C_WriteByte(uint8_t addr, uint8_t data)
{
	uint8_t TxData[2] = {addr, data};
	HAL_I2C_Master_Transmit(&IICx, OLED_ADD, (uint8_t *)TxData, 2, 10);
}

/**
 * @brief 设置起点坐标,左上角为（0，0）
 * @param x 横坐标，0 <= x <= 127
 * @param y 竖坐标，0 <= y <= 7
 * @retval
 */
void SetStart(uint8_t x, uint8_t y)
{
	WriteCmd(0xb0 + y);
	x += 2;
	WriteCmd((x & 0xf0) >> 4 | 0x10); // 取高位
	WriteCmd(((x & 0x0f)));			  // 取低位
}

/**
 * @brief 全屏填充
 * @param Fill_Data 需要填充的数据，0x00~0xff
 * @retval 无
 */
void OLED_Fill(uint8_t Fill_Data)
{
	uint8_t m, n;
	for (m = 0; m < OLED_HEIGHT / 8; m++)
	{
		SetStart(0, m);
		for (n = 0; n < OLED_WIDTH; n++)
		{
			HAL_I2C_WriteByte(OLED_DAT, Fill_Data);
		}
	}
}

/**
 * @brief 打开OLED
 * @retval 无
 */
void OLED_ON(void)
{
	WriteCmd(0X8D); // 设置电荷泵
	WriteCmd(0X14); // 开启电荷泵
	WriteCmd(0XAF); // OLED唤醒
}

/**
 * @brief 关闭OLED
 * @retval 无
 */
void OLED_OFF(void)
{
	WriteCmd(0X8D); // 设置电荷泵
	WriteCmd(0X10); // 关闭电荷泵
	WriteCmd(0XAE); // 关闭OLED
}

/**
 * @brief 单个字符显示
 * @note 本程序中字体大小6*8，所以128的宽度只能显示21个字符，64的高度只能显示8个字符，且位置固定，需要任意坐标自行设计
 * @param x 横坐标，0 <= x <= 20
 * @param y 竖坐标，0 <= y <= 7
 * @param c 字符
 * @retval 无
 */
void Display_Char(uint8_t x, uint8_t y, char c)
{
	uint8_t i;
	SetStart(x * 6, y);
	for (i = 0; i < 6; i++)
	{
		HAL_I2C_WriteByte(OLED_DAT, ASCLL_6x8[c - 32][i]);
	}
}

/**
 * @brief 字符串显示
 * @note 本程序中字体大小6*8，所以128的宽度只能显示21个字符，超过自动换行
 * 	64的高度只能显示8个字符，且位置固定，需要任意坐标自行设计
 * @param x 横坐标，0 <= x <= 20
 * @param y 竖坐标，0 <= y <= 7
 * @param str 字符串
 * @retval 无
 */
void Display_Str(uint8_t x, uint8_t y, char *str)
{
	uint8_t i = 0;
	while (str[i] != '\0')
	{
		Display_Char(x, y, str[i]);
		x++;
		i++;
		if (x >= 21)
		{
			y++;
			x = 0;
		}
	}
}

/**
 * @brief 图片全屏显示
 * @param img 图片数组，大小8*128
 * @param mode 显示模式：mode=0，值为1的像素点显示黑色，值为0的像素点显示白色
 * 					 mode=1，值为1的像素点显示白色，值为0的像素点显示黑色
 * @retval 无
 */
void Display_IMG(const uint8_t (*img)[128], uint8_t mode)
{
	uint8_t i, j;
	for (i = 0; i < OLED_HEIGHT / 8; i++)
	{
		for (j = 0; j < OLED_WIDTH; j++)
		{
			SetStart(j, i);
			if (mode)
				HAL_I2C_WriteByte(OLED_DAT, img[i][j]);
			else
				HAL_I2C_WriteByte(OLED_DAT, ~img[i][j]);
		}
	}
}

/****************************/
/*下方为测试部分，在main中调用就行，可以测试自己的硬件或连线是否正确 */
const uint8_t yuanshen[8][128] = {
	0x00, 0x00, 0x00, 0x00, 0x00, 0x00, 0x00, 0x00, 0x00, 0x00, 0x00, 0x00,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 0x00,
	0x00, 0x00, 0x00, 0x00, 0x00, 0x00, 0x00, 0x00, 0x00, 0x00, 0x00, 0x00,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 0x00,
	0x00, 0x00, 0x00, 0x00, 0x00, 0x00, 0x00, 0x00, 0x00, 0x00, 0x00, 0x00,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 0x00,
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	0x00, 0x00, 0x00, 0x00, 0x00, 0x00, 0x00, 0x00, 0x00, 0x00, 0x00, 0x00,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 0x00
	/*屏幕截图 2024-05-02 230304 - 副本(1).png,0*/
	/* (128 X 64 , 宋体 ) */
};
/**
 * @brief 图片显示测试
 *
 */
void OLED_IMGtest(void)
{
	OLED_Init();
	OLED_Fill(0x00);
	Display_IMG(yuanshen, 0);
}
/**
 * @brief 字符显示测试
 *
 */
void OLED_CHARtest(void)
{
	OLED_Init();
	OLED_Fill(0x00);
	char test_str[] = "Hello World";
	Display_Str(0, 0, test_str);
}
